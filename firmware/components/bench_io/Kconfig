## firmware/components/bench_io/Kconfig
```kconfig
menu "Lab bench: BOOTSEL and RUN lines of the host board"

    config LAB_BENCH_IO
        bool "Drive the host's BOOTSEL (user button) and RUN lines"
        default y
        help
            Two open-drain GPIOs, each through a 1 kOhm series resistor, so a script can press
            the host's button, reset it or put it in its USB bootloader. Test bench only:
            pressing the button from software defeats user presence.

    config LAB_BENCH_BOOTSEL_GPIO
        int "GPIO wired (through 1k) to the host's BOOTSEL / button line (-1 = unused)"
        depends on LAB_BENCH_IO
        range -1 48
        default 4

    config LAB_BENCH_RUN_GPIO
        int "GPIO wired (through 1k) to the host's RUN (reset) line (-1 = unused)"
        depends on LAB_BENCH_IO
        range -1 48
        default 5

endmenu
```

## firmware/components/fp_emu/Kconfig
```kconfig
menu "Lab bench: fingerprint sensor emulator (R502-F Pro)"

    config LAB_FP_EMU
        bool "Emulate a GROW R502-F Pro fingerprint module on a UART"
        default n
        help
            Speaks the module's packet protocol (EF01 header, 57600 8N1 by default) from its user
            manual (V1.1, 2024-03): every documented command, template and image transfers,
            password, address, notepad, AutoEnroll / AutoIdentify, the 0x55 byte at power-on, the
            WAKEUP (touch) line and the host-switched main power. Which "finger" is on the
            sensor, image quality and faults are set from the console ("fp ..."). Test bench
            only: anything that speaks this UART impersonates the sensor, by design.

    config LAB_FP_UART_NUM
        int "UART peripheral"
        depends on LAB_FP_EMU
        range 1 2
        default 1

    config LAB_FP_TX_GPIO
        int "TX GPIO (module TXD, to the host's RX)"
        depends on LAB_FP_EMU
        range 0 48
        default 6

    config LAB_FP_RX_GPIO
        int "RX GPIO (module RXD, from the host's TX)"
        depends on LAB_FP_EMU
        range 0 48
        default 7

    config LAB_FP_WAKEUP_GPIO
        int "WAKEUP GPIO (touch output: low while a finger is on the sensor; -1 = unused)"
        depends on LAB_FP_EMU
        range -1 48
        default 15

    config LAB_FP_POWER_GPIO
        int "Main power GPIO, read from the host (-1 = module always powered)"
        depends on LAB_FP_EMU
        range -1 48
        default 16
        help
            The host's power switch for the module's main supply (on the Cardea Key PCB, the
            gate of the AO3401A P-MOSFET). The emulator reads it: with the module off it does
            not answer, its TX floats and its RAM buffers are lost, as on the real module.
            The input has a pull-up, so a host pin left floating means "off" (as the PCB's
            gate pull-up does).

    config LAB_FP_POWER_ACTIVE_LOW
        bool "Power line is active low (0 = module powered)"
        depends on LAB_FP_EMU && LAB_FP_POWER_GPIO >= 0
        default y

    config LAB_FP_CAPACITY
        int "Template library size"
        depends on LAB_FP_EMU
        range 1 1500
        default 1500

endmenu
```

## firmware/components/lab_common/Kconfig
```kconfig
menu "Lab bench: common (status LED, console)"

    config LAB_LED_GPIO
        int "GPIO of the on-board WS2812 status LED (-1 = no LED)"
        range -1 48
        default 48
        help
            The LED stays off and only gives short, dim flashes for events (green: connected,
            red: error, amber: watchdog).

endmenu
```

## firmware/components/se05x_bridge/Kconfig
```kconfig
menu "Lab bench: SE05x bridge (I2C target <-> SE050Sim over TCP)"

    config LAB_SE05X_BRIDGE
        bool "Stand in for an NXP SE05x on I2C, relaying to the simulator over Wi-Fi"
        default y
        help
            I2C target at the SE05x address; each T=1 frame is relayed to SE050Sim over TCP.
            Needs config.local.h (Wi-Fi and simulator address). The simulator keeps keys in
            clear behind an unauthenticated socket: trusted lab network only.

    config LAB_SE05X_I2C_SDA
        int "I2C SDA GPIO"
        depends on LAB_SE05X_BRIDGE
        range 0 48
        default 8

    config LAB_SE05X_I2C_SCL
        int "I2C SCL GPIO"
        depends on LAB_SE05X_BRIDGE
        range 0 48
        default 9

    config LAB_SE05X_I2C_ADDR
        hex "I2C target address (7 bits)"
        depends on LAB_SE05X_BRIDGE
        range 0x08 0x77
        default 0x48

    config LAB_SE05X_FILL_AFTER_HEADER
        bool "Insert a filler byte after NAD+PCB (ESP32-S3 drops one byte after a 2-byte read)"
        depends on LAB_SE05X_BRIDGE
        default y

endmenu
```
